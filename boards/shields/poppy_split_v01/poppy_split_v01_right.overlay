// This file was generated from a template. Edit it to match your keyboard.
// See https://zmk.dev/docs/development/hardware-integration/new-shield for more
// instructions.

#include "poppy_split_v01.dtsi"

&default_transform {
    // Set this to the number of columns on the left side.
    col-offset = <7>;
};

&kscan {
    // RP2040 GP numbers (silkscreen). Column 7 is the leftmost column of this half.
    col-gpios
        = <&gpio0 14 GPIO_ACTIVE_HIGH>  // col 7:  GP14, bottom edge
        , <&gpio0 15 GPIO_ACTIVE_HIGH>  // col 8:  GP15, bottom edge
        , <&gpio0 16 GPIO_ACTIVE_HIGH>  // col 9:  GP16, bottom edge
        , <&gpio0 21 GPIO_ACTIVE_HIGH>  // col 10: GP21, right edge (bottom corner)
        , <&gpio0 23 GPIO_ACTIVE_HIGH>  // col 11: GP23, right edge
        , <&gpio0 22 GPIO_ACTIVE_HIGH>  // col 12: GP22, right edge
        , <&gpio0 26 GPIO_ACTIVE_HIGH>  // col 13: GP26, right edge
        ;
};
