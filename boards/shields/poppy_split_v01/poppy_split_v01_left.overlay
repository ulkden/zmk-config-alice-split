// This file was generated from a template. Edit it to match your keyboard.
// See https://zmk.dev/docs/development/hardware-integration/new-shield for more
// instructions.

#include "poppy_split_v01.dtsi"

&kscan {
    // RP2040 GP numbers (silkscreen). Column 0 is the leftmost column of this half.
    col-gpios
        = <&gpio0 14 GPIO_ACTIVE_HIGH>  // col 0: GP14, bottom edge
        , <&gpio0 15 GPIO_ACTIVE_HIGH>  // col 1: GP15, bottom edge
        , <&gpio0 16 GPIO_ACTIVE_HIGH>  // col 2: GP16, bottom edge
        , <&gpio0 21 GPIO_ACTIVE_HIGH>  // col 3: GP21, right edge (bottom corner)
        , <&gpio0 23 GPIO_ACTIVE_HIGH>  // col 4: GP23, right edge
        , <&gpio0 22 GPIO_ACTIVE_HIGH>  // col 5: GP22, right edge
        , <&gpio0 26 GPIO_ACTIVE_HIGH>  // col 6: GP26, right edge
        ;
};
