## boards/shields/poppy_split_v01/Kconfig.defconfig
```kconfig
if SHIELD_POPPY_SPLIT_V01_LEFT

config ZMK_KEYBOARD_NAME
    default "poppy_split_v01"

config ZMK_SPLIT_ROLE_CENTRAL
    default y

endif # SHIELD_POPPY_SPLIT_V01_LEFT

if SHIELD_POPPY_SPLIT_V01_LEFT || SHIELD_POPPY_SPLIT_V01_RIGHT

config ZMK_SPLIT
    default y

endif # SHIELD_POPPY_SPLIT_V01_LEFT || SHIELD_POPPY_SPLIT_V01_RIGHT
```

## boards/shields/poppy_split_v01/Kconfig.shield
```kconfig
config SHIELD_POPPY_SPLIT_V01_LEFT
    def_bool $(shields_list_contains,poppy_split_v01_left)

config SHIELD_POPPY_SPLIT_V01_RIGHT
    def_bool $(shields_list_contains,poppy_split_v01_right)
```
